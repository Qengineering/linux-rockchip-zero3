## drivers/dma-buf/heaps/Kconfig
```kconfig
config DMABUF_HEAPS_SYSTEM
	bool "DMA-BUF System Heap"
	depends on DMABUF_HEAPS
        select DMABUF_HEAPS_SYSTEM_DMA32
	help
	  Choose this option to enable the system dmabuf heap. The system heap
	  is backed by pages from the buddy allocator. If in doubt, say Y.

config DMABUF_HEAPS_SYSTEM_DMA32
	bool "DMA‑BUF System DMA32 Heap"
	depends on DMABUF_HEAPS_SYSTEM
	help
	  Enables a separate heap that allocates <4 GB DMA memory.

config DMABUF_HEAPS_CMA
	bool "DMA-BUF CMA Heap"
	depends on DMABUF_HEAPS && DMA_CMA
	help
	  Choose this option to enable dma-buf CMA heap. This heap is backed
	  by the Contiguous Memory Allocator (CMA). If your system has these
	  regions, you should say Y here.

config DMABUF_HEAPS_SRAM
	tristate "Export on-chip SRAM pools using DMA-Heaps"
	depends on DMABUF_HEAPS && SRAM
	help
	  This driver allows the export of on-chip SRAM marked as exportable
	  to userspace using the DMA-Heaps interface.
```
